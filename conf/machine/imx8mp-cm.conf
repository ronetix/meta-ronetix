## conf/machine/imx8mp-cm.conf
```bitbake
#@TYPE: Machine
#@NAME: Ronetix iMX8MP-CM
#@SOC: i.MX8MP
#@DESCRIPTION: Machine configuration for Ronetix iMX8MP-CM
#@MAINTAINER: Ilko Iliev <iliev@ronetix.at>
#
# http://www.ronetix.at
MACHINEOVERRIDES =. "mx8mp:"

require conf/machine/include/imx-base.inc
require conf/machine/include/arm/armv8a/tune-cortexa53.inc

require ronetix.inc

# Ronetix BSP default providers
PREFERRED_PROVIDER_virtual/kernel:imx8mp-cm ?= "linux-ronetix"
PREFERRED_PROVIDER_u-boot:imx8mp-cm ?= "u-boot-ronetix"
PREFERRED_PROVIDER_u-boot-fw-utils:imx8mp-cm ?= "u-boot-fw-utils"
PREFERRED_PROVIDER_virtual/bootloader:imx8mp-cm ?= "u-boot-ronetix"

#MACHINE_FEATURES += "pci wifi bluetooth"

MACHINE_FEATURES_IMX_REMOVALS += " nxp8801-sdio nxp8987-sdio nxp8997-pcie nxp8997-sdio nxp9098-pcie nxp9098-sdio nxpiw416-sdio nxpiw612-sdio"


KERNEL_DEVICETREE += " \
      freescale/imx8mp-cm.dtb \
"

LOCALVERSION = "-imx8mp"
KBUILD_DEFCONFIG:mx8-nxp-bsp = "imx8mp_cm_defconfig"

UBOOT_DTB_NAME = "imx8mp-cm.dtb"

LOADADDR = ""
UBOOT_SUFFIX = "bin"
UBOOT_MAKE_TARGET = ""

SPL_BINARY = "spl/u-boot-spl.bin"

UBOOT_CONFIG ??= "sd"
UBOOT_CONFIG[sd]   = "imx8mp_cm_defconfig,sdcard"

# Set ATF platform name
ATF_PLATFORM = "imx8mp"

IMXBOOT_TARGETS_SD   = "flash_evk"
IMXBOOT_TARGETS = "${IMXBOOT_TARGETS_SD}"

IMX_BOOT_SOC_TARGET = "iMX8MP"
IMX_BOOT_SEEK = "32"

OPTEE_BIN_EXT = "8mp"
TEE_LOAD_ADDR = "0x56000000"

# Extra firmware package name, that is required to build boot container for fslc bsp
IMX_EXTRA_FIRMWARE = "firmware-imx-8m"

# We have to disable SERIAL_CONSOLE due to auto-serial-console
SERIAL_CONSOLES = "115200;ttymxc1"

# Set DDR FIRMWARE
DDR_FIRMWARE_VERSION = "202006"
DDR_FIRMWARE_NAME = " \
    lpddr4_pmu_train_1d_dmem_${DDR_FIRMWARE_VERSION}.bin \
    lpddr4_pmu_train_1d_imem_${DDR_FIRMWARE_VERSION}.bin \
    lpddr4_pmu_train_2d_dmem_${DDR_FIRMWARE_VERSION}.bin \
    lpddr4_pmu_train_2d_imem_${DDR_FIRMWARE_VERSION}.bin \
"


MACHINE_EXTRA_RDEPENDS += " \
        iperf3 \
		alsa-utils \
		stress-ng \
"
```

## conf/machine/rnx-imx93-osm.conf
```bitbake
#@TYPE: Machine
#@NAME: Ronetix RNX-iMX93-OSM
#@SOC: i.MX93
#@DESCRIPTION: Machine configuration for Ronetix RNX-iMX93-OSM
#@MAINTAINER: Ilko Iliev <iliev@ronetix.at>
#
# http://www.ronetix.at
MACHINEOVERRIDES =. "mx93:"

require conf/machine/include/imx-base.inc
require conf/machine/include/arm/armv8-2a/tune-cortexa55.inc

require ronetix.inc

# Ronetix BSP default providers
PREFERRED_PROVIDER_virtual/kernel:rnx-imx93-osm ?= "linux-ronetix"
PREFERRED_PROVIDER_u-boot:rnx-imx93-osm ?= "u-boot-ronetix"
PREFERRED_PROVIDER_u-boot-fw-utils:rnx-imx93-osm ?= "u-boot-fw-utils"
PREFERRED_PROVIDER_virtual/bootloader:rnx-imx93-osm ?= "u-boot-ronetix"

MACHINE_FEATURES += "pci wifi bluetooth"

#KERNEL_DEVICETREE = " \
#    freescale/rnx-imx93-osm.dtb \
#"

KERNEL_DEVICETREE += " \
      freescale/imx93-osm.dtb \
"

UBOOT_DTB_NAME = "rnx-imx93-osm.dtb"

LOADADDR = ""
UBOOT_SUFFIX = "bin"
UBOOT_MAKE_TARGET = ""

SPL_BINARY = "spl/u-boot-spl.bin"

UBOOT_CONFIG ??= "sd"
UBOOT_CONFIG[sd]   = "imx93_osm_defconfig,sdcard"

# Set ATF platform name
ATF_PLATFORM = "imx93"

IMXBOOT_TARGETS_SD   = "flash_singleboot"
IMXBOOT_TARGETS = "${IMXBOOT_TARGETS_SD}"

IMX_BOOT_SOC_TARGET = "iMX9"
IMX_BOOT_SEEK = "32"

# We have to disable SERIAL_CONSOLE due to auto-serial-console
SERIAL_CONSOLES = "115200;ttyLP0"

# Add additional firmware
MACHINE_FIRMWARE:append = " ethos-u-firmware"

DDR_FIRMWARE_NAME = " \
        lpddr4_dmem_1d_v202201.bin \
        lpddr4_dmem_2d_v202201.bin \
        lpddr4_imem_1d_v202201.bin \
        lpddr4_imem_2d_v202201.bin \
"

# For i.MX93 rev A0.
# Note: flash.bin doesn't boot with wrong ahab-container.img
SOC_REV_OPTION:mx93-generic-bsp  = "REV=A0"
SECO_FIRMWARE_NAME:mx93-generic-bsp = "mx93a0-ahab-container.img"

# For i.MX93 rev A1
# Note: flash.bin doesn't boot with wrong ahab-container.img
#SOC_REV_OPTION:mx93-generic-bsp  = "REV=A1"
#SECO_FIRMWARE_NAME:mx93-generic-bsp = "mx93a1-ahab-container.img"

MACHINE_EXTRA_RDEPENDS += " \
        iperf3 \
		alsa-utils \
		stress-ng \
"

MACHINE_EXTRA_RDEPENDS += " \
        linux-firmware-bcm43752 \
"
```

## conf/machine/ronetix.inc
```bitbake
IMX_DEFAULT_BOOTLOADER = "u-boot-ronetix"
IMX_DEFAULT_BOOTLOADER_mx8 = "u-boot-ronetix"

IMX_DEFAULT_KERNEL = "linux-ronetix"
IMX_DEFAULT_KERNEL_mx7 = "linux-ronetix"
IMX_DEFAULT_KERNEL_mx8 = "linux-ronetix"
IMX_DEFAULT_KERNEL_mx8m = "linux-ronetix"
IMX_DEFAULT_KERNEL_use-mainline-bsp = "linux-ronetix"

IMX_DEFAULT_BSP = "nxp"

# Use gstreamer 1.16 from meta-freescale
PREFERRED_VERSION_gstreamer1.0 ?= "1.16.imx"
PREFERRED_VERSION_gstreamer1.0-plugins-base ?= "1.16.imx"
PREFERRED_VERSION_gstreamer1.0-plugins-good ?= "1.16.imx"
PREFERRED_VERSION_gstreamer1.0-plugins-bad ?= "1.16.imx"
PREFERRED_VERSION_gstreamer1.0-libav ?= "1.16.0"
```
