## conf/machine/imx8mm-compact-2gb-cm.conf
```bitbake
#@TYPE: Machine
#@NAME: Ronetix i.MX8MM-COMPACT-2GB-CM
#@SOC: i.MX8MM
#@DESCRIPTION: Machine configuration for the Ronetix i.MX8MM-COMPACT-2GB-CM SoM
#@MAINTAINER: Ilko Iliev <iliev@ronetix.at>
#
# https://www.ronetix.at

MACHINEOVERRIDES =. "mx8mm:"

KERNEL_DEVICETREE_BASENAME = "imx8mm-compact-2gb-cm"
UBOOT_CONFIG_BASENAME = "imx8mm_compact_2gb_cm"
ATF_PLATFORM = "imx8mm"
RONETIX_BOARD_NAME = "Ronetix i.MX8MM-COMPACT-2GB-CM"

require conf/machine/include/ronetix-imx8m.inc

IMX_BOOT_SEEK = "33"

MACHINE_EXTRA_RDEPENDS += "linux-firmware-bcm43456"
```

## conf/machine/imx8mm-compact-cm.conf
```bitbake
#@TYPE: Machine
#@NAME: Ronetix i.MX8MM-COMPACT-CM
#@SOC: i.MX8MM
#@DESCRIPTION: Machine configuration for the Ronetix i.MX8MM-COMPACT-CM SoM
#@MAINTAINER: Ilko Iliev <iliev@ronetix.at>
#
# https://www.ronetix.at

MACHINEOVERRIDES =. "mx8mm:"

KERNEL_DEVICETREE_BASENAME = "imx8mm-compact-cm"
UBOOT_CONFIG_BASENAME = "imx8mm_compact_cm"
ATF_PLATFORM = "imx8mm"
RONETIX_BOARD_NAME = "Ronetix i.MX8MM-COMPACT-CM"

require conf/machine/include/ronetix-imx8m.inc

IMX_BOOT_SEEK = "33"

MACHINE_EXTRA_RDEPENDS += "linux-firmware-bcm4339"
```

## conf/machine/imx8mn-compact-cm.conf
```bitbake
#@TYPE: Machine
#@NAME: Ronetix i.MX8MN-COMPACT-CM
#@SOC: i.MX8MN
#@DESCRIPTION: Machine configuration for the Ronetix i.MX8MN-COMPACT-CM SoM
#@MAINTAINER: Ilko Iliev <iliev@ronetix.at>
#
# https://www.ronetix.at

MACHINEOVERRIDES =. "mx8mn:"

KERNEL_DEVICETREE_BASENAME = "imx8mn-compact-cm"
UBOOT_CONFIG_BASENAME = "imx8mn_compact_cm"
ATF_PLATFORM = "imx8mn"
RONETIX_BOARD_NAME = "Ronetix i.MX8MN-COMPACT-CM"

require conf/machine/include/ronetix-imx8m.inc

IMX_BOOT_SEEK = "32"

MACHINE_EXTRA_RDEPENDS += "linux-firmware-bcm4339"
```
